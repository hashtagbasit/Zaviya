// SPDX-License-Identifier: BSD-3-Clause
/*
 * AYN Odin 2 Portal units with a Visionox VTDR6130 AMOLED instead of the
 * ICNA3512 (AYN's Android selects qcom,mdss_dsi_vtdr6130_dsc_cmd on them).
 * Supplies as in that Android node: vddio 1.8 V, vdd 2.8 V (GPIO 142),
 * vci 3.0 V; GPIO 52, the panel's backlight enable, is handed over as vdd28
 * so it is on whenever the panel is.
 *
 * Not in DTBS: ABL picks a DTB by model, and how a unit should get this one
 * is open (issue 91). With the model unchanged, this DTB in place of
 * qcs8550-ayn-odin2portal.dtb is what a VTDR6130 unit boots.
 */

#include "qcs8550-ayn-odin2portal.dts"

&display_panel {
	compatible = "vtdr6130,odin2portal";
	vdd-supply = <&vdd_disp_2v8>;
	vdd28-supply = <&vdd_bl_5v0>;
	/delete-property/ disp-supply;
	/delete-property/ blvdd-supply;
};
